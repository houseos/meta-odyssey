## conf/machine/seeed-odyssey.conf
```bitbake
# meta-odyssey
# seeed-odyssey.conf
# SPDX-License-Identifier: MIT
# Copyright (C) 2020 Benjamin Schilling

IMAGE_TYPE = "wic-swu-img"

DISTRO_ARCH ?= "amd64"
```

## wic/seeed-odyssey-efibootguard.wks
```
# meta-odyssey
# seeed-odyssey-efibootguard.wks
# SPDX-License-Identifier: MIT
# Copyright (C) 2020 Benjamin Schilling

include ebg-sysparts.inc

include swupdate-partition.inc

# Persistent data partition
part data --ondisk sda --fstype=ext4 --label data --align 1024 --size 2000M

# Disable kernel command line, because it somehow does not finish booting with it enabled and it is not needed for now
bootloader --ptable gpt --append="rootwait earlyprintk"
```
